## drivers/sensor/Kconfig
```kconfig
# Copyright (c) 2024 CATIE
# SPDX-License-Identifier: Apache-2.0

if SENSOR

rsource "ldrobot/Kconfig"

endif # SENSOR
```

## drivers/sensor/ld19/Kconfig
```kconfig
# Copyright (c) 2024 CATIE
# SPDX-License-Identifier: Apache-2.0

menuconfig LD19
	bool "LDROBOT LD19 lidar sensor"
	default y
	depends on DT_HAS_LDROBOT_LD19_ENABLED
	help
	  Enable driver for LDROBOT LD19 lidar sensor.

choice
	prompt "Trigger mode"
	default LD19_TRIGGER_NONE
	help
	  Specify the type of triggering used by the driver.

config LD19_TRIGGER_NONE
	bool "No trigger"

config LD19_TRIGGER_GLOBAL_THREAD
	bool "Use global thread"
	depends on GPIO
	select LD19_TRIGGER

config LD19_TRIGGER_OWN_THREAD
	bool "Use own thread"
	depends on GPIO
	select LD19_TRIGGER

endchoice

config LD19_TRIGGER
	bool
	help
	  Enable trigger support for LDROBOT LD19 lidar sensor.
```

## drivers/sensor/ldrobot/Kconfig
```kconfig
# Copyright (c) 2024 CATIE
# SPDX-License-Identifier: Apache-2.0

if SENSOR

rsource "ld19/Kconfig"

endif # SENSOR
```

## dts/bindings/sensor/ldrobot,ld19.yaml
```yaml
# Copyright (c) 2024 CATIE
# SPDX-License-Identifier: Apache-2.0

description: |
    LDROBOT Co. ld19 lidar sensor.

compatible: "ldrobot,ld19"

include: [sensor-device.yaml]
```
